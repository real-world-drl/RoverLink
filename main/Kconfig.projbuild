## main/Kconfig.projbuild
```kconfig
# SPDX-License-Identifier: Apache-2.0
# Copyright 2026 Peter Bohm

menu "UGV firmware"

    config UGV_ROBOT_ID
        string "Robot ID (used in MQTT topic prefix)"
        default "ugv01"
        help
            Substituted into topics: ugv/<id>/v1/...

    menu "Transports"
        config UGV_ENABLE_MQTT
            bool "Enable MQTT over WiFi"
            default y
            help
                Brings up WiFi STA + the esp-mqtt client. Disable to save
                ~1.5 s of boot time and ~40 KB of RAM when only the UART
                link is needed.

        config UGV_ENABLE_UART_LINK
            bool "Enable UART link to host"
            default y
            help
                Direct binary link to the upper computer — same packet
                structs as MQTT, framed with sync + type + length + CRC8.
                When both transports are enabled, a recent UART RX frame
                masks MQTT cmd_vel for UGV_UART_PREEMPT_MS to prevent
                stale broker packets from stomping on live wire commands.

        config UGV_UART_PORT
            int "UART port number (0=UART0/console header, 2=UART2)"
            depends on UGV_ENABLE_UART_LINK
            default 0
            range 0 2
            help
                Which ESP32 UART peripheral the binary link uses. The
                board's RX/TX header is wired to UART0 (U0TX=GPIO1,
                U0RX=GPIO3). Using UART0 requires the console be disabled
                (ESP_CONSOLE_NONE), since they cannot share the line.

        config UGV_UART_BAUD
            int "UART baud rate"
            depends on UGV_ENABLE_UART_LINK
            default 921600

        config UGV_UART_TX_PIN
            int "UART TX GPIO"
            depends on UGV_ENABLE_UART_LINK
            default 1
            help
                Default 1 is U0TX on the board's RX/TX header. Do NOT use
                GPIO 17 (motor AIN2) or 16 (right encoder B).

        config UGV_UART_RX_PIN
            int "UART RX GPIO"
            depends on UGV_ENABLE_UART_LINK
            default 3
            help
                Default 3 is U0RX on the board's RX/TX header. Do NOT use
                GPIO 17 (motor AIN2) or 16 (right encoder B).

        config UGV_UART_PREEMPT_MS
            int "UART preempt window over MQTT (ms)"
            depends on UGV_ENABLE_UART_LINK
            default 1000
            range 0 60000
    endmenu

    menu "WiFi"
        depends on UGV_ENABLE_MQTT
        config UGV_WIFI_SSID
            string "WiFi SSID"
            default "your-ssid"

        config UGV_WIFI_PASS
            string "WiFi password"
            default "your-password"

        config UGV_WIFI_MAX_RETRY
            int "Max reconnect attempts before giving up"
            default 20
    endmenu

    menu "MQTT"
        depends on UGV_ENABLE_MQTT
        config UGV_MQTT_BROKER_URI
            string "Broker URI (e.g. mqtt://192.168.1.100:1883)"
            default "mqtt://192.168.1.100:1883"

        config UGV_MQTT_USERNAME
            string "Username (blank for none)"
            default ""

        config UGV_MQTT_PASSWORD
            string "Password (blank for none)"
            default ""
    endmenu

    menu "OTA (over-the-air update)"
        depends on UGV_ENABLE_MQTT
        config UGV_OTA_VALIDATE_TIMEOUT_MS
            int "Rollback watchdog: ms to reach MQTT before reverting"
            default 120000
            range 10000 600000
            help
                With rollback enabled, a freshly OTA'd image boots in
                PENDING_VERIFY and must prove itself healthy by
                reconnecting to the broker. If MQTT is not connected
                within this window the image is marked invalid and the
                bootloader rolls back to the previous slot on reboot.
                This is the safety net for an unreachable rover — keep it
                long enough to cover WiFi association + broker connect.
    endmenu

    menu "Robot kinematics"
        config UGV_WHEEL_DIAMETER_MM
            int "Wheel diameter (mm)"
            default 80
            range 1 1000

        config UGV_TRACK_WIDTH_MM
            int "Track width / wheel separation (mm)"
            default 172
            range 1 2000

        config UGV_ENCODER_PPR
            int "Encoder PCNT ticks per wheel revolution (after gearing)"
            default 1055
            range 1 100000
            help
                PCNT ticks counted per full wheel-output revolution.

                Current bot: N20 magnetic hall encoder, 1:150 gearbox.
                Datasheet quotes 7 PPR x 150 = 1050. The empirically
                calibrated value is 1055, measured by comparing commanded
                vs. actual travelled distance — this is what to trust.
                Note: despite encoder.c configuring 2x edge counting, the
                measured ticks/rev track the datasheet's ~1050 nominal, not
                double it, so do NOT "correct" this to 2100.

        config UGV_MOTOR_LEFT_INVERT
            bool "Invert LEFT motor direction"
            default n

        config UGV_MOTOR_RIGHT_INVERT
            bool "Invert RIGHT motor direction"
            default n

        config UGV_ENCODER_LEFT_INVERT
            bool "Invert LEFT encoder direction"
            default n

        config UGV_ENCODER_RIGHT_INVERT
            bool "Invert RIGHT encoder direction"
            default n

        config UGV_MAX_LINEAR_MPS_X100
            int "Max |linear_x| (m/s * 100)"
            default 200
            help
                Clamp on incoming cmd_vel. 200 = 2.0 m/s.

        config UGV_MAX_ANGULAR_RPS_X100
            int "Max |angular_z| (rad/s * 100)"
            default 600
            help
                Clamp on incoming cmd_vel. 600 = 6.0 rad/s.
    endmenu

    menu "Control mode"
        config UGV_OPEN_LOOP
            bool "Open-loop control (no PID, no encoder feedback)"
            default n
            help
                Skip the PID entirely and map commanded wheel velocity
                directly to PWM via a configurable scale. Use when the bot
                has no encoders. Trajectory tracking is inaccurate (depends
                on load, battery, slip) but the bot will move roughly
                proportional to cmd_vel. Firmware odometry uses the
                commanded setpoints as a stand-in for measured motion, so
                the OLED still shows non-zero x/y — treat as dead reckoning,
                not truth.

        config UGV_OPEN_LOOP_PWM_PER_MPS_X10
            int "Open-loop scale: PWM counts per m/s × 10"
            depends on UGV_OPEN_LOOP
            default 5120
            help
                PWM applied per m/s of commanded wheel velocity, stored ×10
                so it's an integer in Kconfig. Default 5120 = ×512, i.e.
                ~0.5 m/s commanded saturates PWM at 255. Tune by driving
                the bot at a known cmd_vel and timing it over a known
                distance: scale_x10 = round(255 / actual_mps × 10).
    endmenu

    menu "PID defaults"
        config UGV_PID_KP_X1000
            int "kp * 1000"
            default 20000
            help
                Floating-point gains stored as integers here; converted at runtime.

        config UGV_PID_KI_X1000
            int "ki * 1000"
            default 2000000

        config UGV_PID_KD_X1000
            int "kd * 1000"
            default 0

        config UGV_PID_OUTPUT_CLAMP
            int "PID output clamp (PWM counts)"
            default 255

        config UGV_PID_DEADBAND
            int "PWM deadband (output |x|<deadband => 0)"
            default 23
    endmenu

    menu "Timing"
        config UGV_CONTROL_HZ
            int "Control loop rate (Hz)"
            default 100
            range 20 500

        config UGV_TELEMETRY_HZ
            int "Wheel telemetry rate (Hz)"
            default 50
            range 1 200

        config UGV_BATTERY_HZ
            int "Battery telemetry rate (Hz)"
            default 2
            range 1 50

        config UGV_IMU_HZ
            int "IMU sample / publish rate (Hz)"
            default 100
            range 10 500
            help
                The QMI8658 runs at 1 kHz internally; this is the polling
                rate. The AK09918 magnetometer is fixed at 100 Hz; values
                above 100 Hz will repeat mag samples (a "mag_fresh" flag
                in the packet tells the host which samples are new).

        config UGV_HEARTBEAT_TIMEOUT_MS
            int "cmd_vel staleness timeout (ms)"
            default 500
            range 50 10000
    endmenu

    menu "Sensors"
        config UGV_ENABLE_INA219
            bool "Enable INA219 battery monitor"
            default y

        config UGV_INA219_VOLTAGE_SCALE_X1000
            int "INA219 bus-voltage scale ×1000"
            depends on UGV_ENABLE_INA219
            default 1000
            help
                Linear scale applied to the INA219 bus voltage reading
                before display. Default 1000 = ×1.0 (chip reading is the
                actual battery voltage). Tune against a multimeter if your
                board has a voltage divider in front of the chip:
                scale = (V_real / V_read) × 1000.

        config UGV_ENABLE_IMU
            bool "Enable QMI8658 + AK09918 IMU"
            default y

        comment "IMU body-frame axis inversion (display/odometry only)"
            depends on UGV_ENABLE_IMU

        config UGV_IMU_BODY_INVERT_X
            bool "Invert IMU X axis"
            depends on UGV_ENABLE_IMU
            default n

        config UGV_IMU_BODY_INVERT_Y
            bool "Invert IMU Y axis"
            depends on UGV_ENABLE_IMU
            default n

        config UGV_IMU_BODY_INVERT_Z
            bool "Invert IMU Z axis"
            depends on UGV_ENABLE_IMU
            default n
            help
                Applies only to the firmware's display-side odometry —
                flip whichever IMU axes are needed to make body-frame
                roll/pitch read 0 when the bot is level. Raw published
                tel/imu data is unaffected (host calibrates that).
    endmenu

    menu "Display"
        config UGV_ENABLE_DISPLAY
            bool "Enable SSD1306 OLED display"
            default y

        config UGV_DISPLAY_HZ
            int "Display refresh rate (Hz)"
            depends on UGV_ENABLE_DISPLAY
            default 1
            range 1 10

        config UGV_DISPLAY_HOST_TIMEOUT_MS
            int "Host cmd/display staleness timeout (ms)"
            depends on UGV_ENABLE_DISPLAY
            default 2000
            range 100 60000
            help
                If no cmd/display packet has arrived within this window,
                the display falls back to firmware-computed odometry.
                The top-right indicator on the OLED shows H (host) or L
                (local/firmware).
    endmenu

endmenu
```

## sdkconfig.defaults
```kconfig
# Target
CONFIG_IDF_TARGET="esp32"

# 1 kHz tick so vTaskDelayUntil at 100 Hz / 50 Hz lands cleanly
CONFIG_FREERTOS_HZ=1000

# CPU at max
CONFIG_ESP_DEFAULT_CPU_FREQ_MHZ_240=y

# Run app on both cores; pin tasks explicitly
CONFIG_FREERTOS_UNICORE=n

# Larger main task stack for init code
CONFIG_ESP_MAIN_TASK_STACK_SIZE=4096

# MQTT
CONFIG_MQTT_PROTOCOL_311=y
CONFIG_MQTT_TRANSPORT_SSL=n
CONFIG_MQTT_TRANSPORT_WEBSOCKET=n

# Compiler
CONFIG_COMPILER_OPTIMIZATION_PERF=y
CONFIG_COMPILER_WARN_WRITE_STRINGS=y

# Logs
CONFIG_LOG_DEFAULT_LEVEL_INFO=y

# Serial console off: the board's RX/TX header is wired to UART0, which now
# carries the binary link (CONFIG_UGV_UART_PORT=0). A UART can't share log
# text with binary frames, so the console gives up the line. Runtime logs
# are dropped — use MQTT, or repoint the console at a spare UART to debug.
CONFIG_ESP_CONSOLE_NONE=y

# Flash + OTA: 4 MB part with two app slots (partitions.csv) for wireless
# updates, plus rollback so an image that can't get back online reverts.
CONFIG_ESPTOOLPY_FLASHSIZE_4MB=y
CONFIG_ESPTOOLPY_HEADER_FLASHSIZE_UPDATE=y
CONFIG_PARTITION_TABLE_CUSTOM=y
CONFIG_PARTITION_TABLE_CUSTOM_FILENAME="partitions.csv"
CONFIG_BOOTLOADER_APP_ROLLBACK_ENABLE=y

# Allow plain-HTTP OTA on the trusted LAN (no TLS cert to manage).
CONFIG_ESP_HTTPS_OTA_ALLOW_HTTP=y
```
